## Documentation/devicetree/bindings/input/awinic,aw86927.yaml
```yaml
# SPDX-License-Identifier: (GPL-2.0-only OR BSD-2-Clause)
%YAML 1.2
---
$id: http://devicetree.org/schemas/input/awinic,aw86927.yaml#
$schema: http://devicetree.org/meta-schemas/core.yaml#

title: Awinic AW86927 LRA Haptic IC

maintainers:
  - Griffin Kroah-Hartman <griffin.kroah@fairphone.com>

properties:
  compatible:
    oneOf:
      - enum:
          - awinic,aw86927
          - awinic,aw86937
      - items:
          - enum:
              - awinic,aw86938
          - const: awinic,aw86927

  firmware-name:
    description: RAM waveform image containing checksum, base address and waveform table.
    maxItems: 1

  awinic,ram-waveform-index:
    description: One-based index of the periodic rumble waveform in the RAM image.
    $ref: /schemas/types.yaml#/definitions/uint32
    minimum: 1
    maximum: 127
    default: 1

  reg:
    maxItems: 1

  reset-gpios:
    maxItems: 1

  interrupts:
    maxItems: 1

required:
  - compatible
  - reg
  - reset-gpios
  - interrupts

allOf:
  - if:
      properties:
        compatible:
          contains:
            const: awinic,aw86937
    then:
      required:
        - firmware-name

additionalProperties: false

examples:
  - |
    #include <dt-bindings/gpio/gpio.h>
    #include <dt-bindings/interrupt-controller/irq.h>

    i2c {
        #address-cells = <1>;
        #size-cells = <0>;

        vibrator@5a {
            compatible = "awinic,aw86927";
            reg = <0x5a>;
            interrupts-extended = <&tlmm 101 IRQ_TYPE_EDGE_FALLING>;
            reset-gpios = <&tlmm 100 GPIO_ACTIVE_LOW>;
        };
    };
```

## Documentation/devicetree/bindings/input/touchscreen/novatek,nt36536-ts.yaml
```yaml
# SPDX-License-Identifier: (GPL-2.0-only OR BSD-2-Clause)
%YAML 1.2
---
$id: http://devicetree.org/schemas/input/touchscreen/novatek,nt36536-ts.yaml#
$schema: http://devicetree.org/meta-schemas/core.yaml#

title: Novatek NT36536 SPI touchscreen controller

maintainers:
  - phone-devel maintainers <phone-devel@vger.kernel.org>

description:
  The NT36536 is a no-flash capacitive touchscreen controller. Its firmware
  must be downloaded to SRAM by the host after reset and after power loss.

allOf:
  - $ref: touchscreen.yaml#
  - $ref: /schemas/spi/spi-peripheral-props.yaml#

properties:
  compatible:
    const: novatek,nt36536-ts

  reg:
    maxItems: 1

  interrupts:
    maxItems: 1

  firmware-name:
    maxItems: 1
    description: Firmware file containing the Novatek host-download image.

  spi-max-frequency:
    maximum: 10000000

required:
  - compatible
  - reg
  - interrupts
  - firmware-name
  - spi-max-frequency
  - touchscreen-size-x
  - touchscreen-size-y

unevaluatedProperties: false

examples:
  - |
    #include <dt-bindings/interrupt-controller/irq.h>

    spi {
        #address-cells = <1>;
        #size-cells = <0>;

        touchscreen@0 {
            compatible = "novatek,nt36536-ts";
            reg = <0>;

            interrupt-parent = <&tlmm>;
            interrupts = <162 IRQ_TYPE_EDGE_FALLING>;

            spi-max-frequency = <10000000>;
            firmware-name = "novatek_ts_fw.bin";
            touchscreen-size-x = <19041>;
            touchscreen-size-y = <30401>;
        };
    };
...
```

## Documentation/devicetree/bindings/media/i2c/galaxycore,gc08a8.yaml
```yaml
# SPDX-License-Identifier: (GPL-2.0 OR BSD-2-Clause)
# Copyright (c) 2023 MediaTek Inc.
%YAML 1.2
---
$id: http://devicetree.org/schemas/media/i2c/galaxycore,gc08a8.yaml#
$schema: http://devicetree.org/meta-schemas/core.yaml#

title: GalaxyCore gc08a8 1/4" 8M Pixel MIPI CSI-2 sensor

maintainers:
  - Elden Mainline Agent <elden-mainline@localhost>

description:
  The gc08a8 is a raw image sensor with an MIPI CSI-2 image data
  interface and CCI (I2C compatible) control bus. The output format
  is raw Bayer.

allOf:
  - $ref: /schemas/media/video-interface-devices.yaml#

properties:
  compatible:
    const: galaxycore,gc08a8

  reg:
    maxItems: 1

  clocks:
    maxItems: 1
    description: 19.2 MHz input clock.

  dovdd-supply: true

  avdd-supply: true

  dvdd-supply: true

  power-domains:
    maxItems: 1

  reset-gpios:
    description: Reference to the GPIO connected to the RESETB pin.
    maxItems: 1

  port:
    $ref: /schemas/graph.yaml#/$defs/port-base
    additionalProperties: false
    description:
      Output port node, single endpoint describing the CSI-2 transmitter.

    properties:
      endpoint:
        $ref: /schemas/media/video-interfaces.yaml#
        unevaluatedProperties: false

        properties:
          data-lanes:
            items:
              - const: 1
              - const: 2
              - const: 3
              - const: 4

          link-frequencies:
            items:
              - const: 336000000

        required:
          - data-lanes
          - link-frequencies

    required:
      - endpoint

required:
  - compatible
  - reg
  - clocks
  - dovdd-supply
  - avdd-supply
  - dvdd-supply
  - reset-gpios
  - port

unevaluatedProperties: false

examples:
  - |
    #include <dt-bindings/gpio/gpio.h>

    i2c {
        #address-cells = <1>;
        #size-cells = <0>;

        sensor@31 {
            compatible = "galaxycore,gc08a8";
            reg = <0x31>;

            clocks = <&gc08a8_clk>;

            reset-gpios = <&pio 19 GPIO_ACTIVE_LOW>;

            avdd-supply = <&gc08a8_avdd>;
            dovdd-supply = <&gc08a8_dovdd>;
            dvdd-supply = <&gc08a8_dvdd>;

            port {
                sensor_out: endpoint {
                    data-lanes = <1 2 3 4>;
                    link-frequencies = /bits/ 64 <336000000>;
                    remote-endpoint = <&seninf_csi_port_0_in>;
                };
            };
        };
    };

...
```

## Documentation/devicetree/bindings/media/i2c/giantec,gt9764.yaml
```yaml
# SPDX-License-Identifier: (GPL-2.0-only OR BSD-2-Clause)
%YAML 1.2
---
$id: http://devicetree.org/schemas/media/i2c/giantec,gt9764.yaml#
$schema: http://devicetree.org/meta-schemas/core.yaml#

title: Giantec GT9764 camera lens actuator

maintainers:
  - Elden Mainline Agent <elden-mainline@localhost>

description:
  I2C-controlled lens actuator with a 10-bit position DAC and advanced actuator
  control (AAC). AAC parameters depend on the lens module's mechanical response.

properties:
  compatible:
    const: giantec,gt9764

  reg:
    maxItems: 1

  vddio-supply:
    description: Digital I/O supply.

  vdd-supply:
    description: Actuator supply, independently switched for the lens.

  giantec,aac-mode:
    $ref: /schemas/types.yaml#/definitions/uint32
    maximum: 255
    description: Module-specified AAC mode configuration (register 0x06).

  giantec,aac-timing:
    $ref: /schemas/types.yaml#/definitions/uint32
    maximum: 255
    description: Module-specified AAC timing configuration (register 0x07).

  settling-time-us:
    minimum: 1
    description:
      Minimum interval after programming a lens position before issuing
      another position command, based on the lens module's damping response.

required:
  - compatible
  - reg
  - vddio-supply
  - vdd-supply
  - giantec,aac-mode
  - giantec,aac-timing
  - settling-time-us

additionalProperties: false

examples:
  - |
    i2c {
        #address-cells = <1>;
        #size-cells = <0>;

        lens@c {
            compatible = "giantec,gt9764";
            reg = <0x0c>;
            vddio-supply = <&camera_io>;
            vdd-supply = <&camera_af>;
            giantec,aac-mode = <0x40>;
            giantec,aac-timing = <0x7c>;
            settling-time-us = <7000>;
        };
    };
```

## Documentation/devicetree/bindings/media/i2c/samsung,s5kjns.yaml
```yaml
# SPDX-License-Identifier: (GPL-2.0 OR BSD-2-Clause)
%YAML 1.2
---
$id: http://devicetree.org/schemas/media/i2c/samsung,s5kjns.yaml#
$schema: http://devicetree.org/meta-schemas/core.yaml#

title: Samsung S5KJNS image sensor

maintainers:
  - Elden Mainline Agent <elden-mainline@localhost>

description:
  The s5kjns is a raw image sensor with an MIPI CSI-2 image data
  interface and CCI (I2C compatible) control bus. The output format
  is raw Bayer.

allOf:
  - $ref: /schemas/media/video-interface-devices.yaml#

properties:
  compatible:
    const: samsung,s5kjns

  reg:
    maxItems: 1

  clocks:
    maxItems: 1
    description: 19.2 MHz input clock.

  dovdd-supply: true

  avdd-supply: true

  dvdd-supply: true

  lens-focus: true

  flash-leds: true

  power-domains:
    maxItems: 1

  reset-gpios:
    description: Reference to the GPIO connected to the RESETB pin.
    maxItems: 1

  port:
    $ref: /schemas/graph.yaml#/$defs/port-base
    additionalProperties: false
    description:
      Output port node, single endpoint describing the CSI-2 transmitter.

    properties:
      endpoint:
        $ref: /schemas/media/video-interfaces.yaml#
        unevaluatedProperties: false

        properties:
          data-lanes:
            items:
              - const: 1
              - const: 2
              - const: 3
              - const: 4

          link-frequencies:
            items:
              - const: 672000000

        required:
          - data-lanes
          - link-frequencies

    required:
      - endpoint

required:
  - compatible
  - reg
  - clocks
  - dovdd-supply
  - avdd-supply
  - dvdd-supply
  - reset-gpios
  - port

unevaluatedProperties: false

examples:
  - |
    #include <dt-bindings/gpio/gpio.h>

    i2c {
        #address-cells = <1>;
        #size-cells = <0>;

        sensor@56 {
            compatible = "samsung,s5kjns";
            reg = <0x56>;

            clocks = <&s5kjns_clk>;

            reset-gpios = <&pio 19 GPIO_ACTIVE_LOW>;

            avdd-supply = <&s5kjns_avdd>;
            dovdd-supply = <&s5kjns_dovdd>;
            dvdd-supply = <&s5kjns_dvdd>;

            port {
                sensor_out: endpoint {
                    data-lanes = <1 2 3 4>;
                    link-frequencies = /bits/ 64 <672000000>;
                    remote-endpoint = <&seninf_csi_port_0_in>;
                };
            };
        };
    };

...
```

## Documentation/devicetree/bindings/regulator/willsemi,wl2868c.yaml
```yaml
# SPDX-License-Identifier: (GPL-2.0-only OR BSD-2-Clause)
%YAML 1.2
---
$id: http://devicetree.org/schemas/regulator/willsemi,wl2868c.yaml#
$schema: http://devicetree.org/meta-schemas/core.yaml#

title: Will Semiconductor WL2868C camera power management IC

maintainers:
  - Elden Mainline Agent <elden-mainline@localhost>

description:
  Seven programmable LDOs with separate inputs for LDO1/2, LDO3/4,
  LDO5, LDO6 and LDO7. LDO1/2 support 0.496 to 1.512 V and LDO3-7
  support 1.504 to 3.544 V, in 8 mV steps.

properties:
  compatible:
    const: willsemi,wl2868c

  reg:
    maxItems: 1

  reset-gpios:
    maxItems: 1
    description: Active-low RST_N input.

  vin12-supply: true
  vin34-supply: true
  vin5-supply: true
  vin6-supply: true
  vin7-supply: true

  regulators:
    type: object
    additionalProperties: false
    patternProperties:
      "^ldo[1-7]$":
        type: object
        $ref: regulator.yaml#
        unevaluatedProperties: false

required:
  - compatible
  - reg
  - regulators

additionalProperties: false

examples:
  - |
    i2c {
        #address-cells = <1>;
        #size-cells = <0>;

        pmic@2f {
            compatible = "willsemi,wl2868c";
            reg = <0x2f>;

            regulators {
                ldo1 {
                    regulator-min-microvolt = <1200000>;
                    regulator-max-microvolt = <1200000>;
                };
            };
        };
    };
```
